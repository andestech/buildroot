## configs/andes_ae350_45_defconfig
```kconfig
BR2_riscv=y
BR2_RISCV_ISA_RVC=y
BR2_PACKAGE_HOST_LINUX_HEADERS_CUSTOM_6_6=y
BR2_GCC_VERSION_14_X=y
BR2_GLOBAL_PATCH_DIR="board/andes/ae350/patches"
BR2_TARGET_GENERIC_GETTY_PORT="ttyS0"
BR2_ROOTFS_POST_BUILD_SCRIPT="board/andes/ae350/post-build.sh"
BR2_ROOTFS_POST_IMAGE_SCRIPT="support/scripts/genimage.sh"
BR2_ROOTFS_POST_SCRIPT_ARGS="-c board/andes/ae350/genimage_sdcard.cfg"
BR2_LINUX_KERNEL=y
BR2_LINUX_KERNEL_CUSTOM_TARBALL=y
BR2_LINUX_KERNEL_CUSTOM_TARBALL_LOCATION="$(call github,andestech,linux,62f0764ee0753220b21eb7da6c5aac0778c61e61)/linux-62f0764ee0753220b21eb7da6c5aac0778c61e61.tar.gz"
BR2_LINUX_KERNEL_DEFCONFIG="ae350_rv64_smp"
BR2_LINUX_KERNEL_CONFIG_FRAGMENT_FILES="board/andes/ae350/linux.config.fragment"
BR2_LINUX_KERNEL_IMAGEGZ=y
BR2_LINUX_KERNEL_DTS_SUPPORT=y
BR2_LINUX_KERNEL_INTREE_DTS_NAME="andes/ax45mp_c4_d_dsp_ae350"
BR2_TARGET_ROOTFS_EXT2=y
BR2_TARGET_ROOTFS_EXT2_4=y
# BR2_TARGET_ROOTFS_TAR is not set
BR2_TARGET_OPENSBI=y
BR2_TARGET_OPENSBI_CUSTOM_TARBALL=y
BR2_TARGET_OPENSBI_CUSTOM_TARBALL_LOCATION="$(call github,andestech,opensbi,6bc151c581803354cd0327b69b9335b32901d537)/opensbi-6bc151c581803354cd0327b69b9335b32901d537.tar.gz"
BR2_TARGET_OPENSBI_PLAT="generic"
# BR2_TARGET_OPENSBI_INSTALL_JUMP_IMG is not set
BR2_TARGET_UBOOT=y
BR2_TARGET_UBOOT_BUILD_SYSTEM_KCONFIG=y
BR2_TARGET_UBOOT_CUSTOM_TARBALL=y
BR2_TARGET_UBOOT_CUSTOM_TARBALL_LOCATION="$(call github,andestech,uboot,274c8e532c6fc30bb680661f420984e1031814cf)/uboot-274c8e532c6fc30bb680661f420984e1031814cf.tar.gz"
BR2_TARGET_UBOOT_BOARD_DEFCONFIG="ae350_rv64_spl_xip"
BR2_TARGET_UBOOT_CONFIG_FRAGMENT_FILES="board/andes/ae350/uboot.config.fragment"
BR2_TARGET_UBOOT_NEEDS_PYLIBFDT=y
BR2_TARGET_UBOOT_NEEDS_OPENSSL=y
BR2_TARGET_UBOOT_NEEDS_OPENSBI=y
# BR2_TARGET_UBOOT_FORMAT_BIN is not set
BR2_TARGET_UBOOT_FORMAT_CUSTOM=y
BR2_TARGET_UBOOT_FORMAT_CUSTOM_NAME="u-boot.itb"
BR2_TARGET_UBOOT_SPL=y
BR2_TARGET_UBOOT_CUSTOM_MAKEOPTS="SWDTB=1"
BR2_PACKAGE_HOST_ANDES_SPI_BURN=y
BR2_PACKAGE_HOST_DOSFSTOOLS=y
BR2_PACKAGE_HOST_GENIMAGE=y
BR2_PACKAGE_HOST_MTOOLS=y
```

## configs/andes_ae350_45_optee_defconfig
```kconfig
BR2_riscv=y
BR2_RISCV_ISA_RVC=y
BR2_TOOLCHAIN_EXTERNAL=y
BR2_TOOLCHAIN_EXTERNAL_BOOTLIN_RISCV64_LP64D_GLIBC_STABLE=y
BR2_GLOBAL_PATCH_DIR="board/andes/ae350-optee/patches"
BR2_TARGET_GENERIC_GETTY_PORT="ttyS0"
BR2_ROOTFS_OVERLAY="board/andes/ae350-optee/rootfs_overlay"
BR2_ROOTFS_POST_BUILD_SCRIPT="board/andes/ae350-optee/post-build.sh"
BR2_ROOTFS_POST_IMAGE_SCRIPT="support/scripts/genimage.sh"
BR2_ROOTFS_POST_SCRIPT_ARGS="-c board/andes/ae350-optee/genimage_sdcard.cfg"
BR2_LINUX_KERNEL=y
BR2_LINUX_KERNEL_CUSTOM_TARBALL=y
BR2_LINUX_KERNEL_CUSTOM_TARBALL_LOCATION="$(call github,andestech,linux,optee_ast540_v4.3)/linux-optee_ast540_v4.3.tar.gz"
BR2_LINUX_KERNEL_DEFCONFIG="ae350_rv64_smp"
BR2_LINUX_KERNEL_CONFIG_FRAGMENT_FILES="board/andes/ae350-optee/linux.config.fragment"
BR2_LINUX_KERNEL_IMAGEGZ=y
BR2_LINUX_KERNEL_DTS_SUPPORT=y
BR2_LINUX_KERNEL_INTREE_DTS_NAME="andes/ax45_c1_d_dsp_noncoherent_ae350_optee"
BR2_PACKAGE_STRACE=y
BR2_PACKAGE_OPTEE_CLIENT_CUSTOM_TARBALL=y
BR2_PACKAGE_OPTEE_CLIENT_CUSTOM_TARBALL_LOCATION="$(call github,OP-TEE,optee_client,4.3.0)/optee_client-4.3.0.tar.gz"
BR2_PACKAGE_OPTEE_EXAMPLES=y
BR2_PACKAGE_OPTEE_EXAMPLES_CUSTOM_TARBALL=y
BR2_PACKAGE_OPTEE_EXAMPLES_CUSTOM_TARBALL_LOCATION="$(call github,linaro-swg,optee_examples,4.3.0)/optee_examples-4.3.0.tar.gz"
BR2_PACKAGE_OPTEE_TEST=y
BR2_PACKAGE_OPTEE_TEST_CUSTOM_TARBALL=y
BR2_PACKAGE_OPTEE_TEST_CUSTOM_TARBALL_LOCATION="$(call github,OP-TEE,optee_test,4.3.0)/optee_test-4.3.0.tar.gz"
BR2_TARGET_ROOTFS_EXT2=y
BR2_TARGET_ROOTFS_EXT2_4=y
BR2_TARGET_ROOTFS_EXT2_SIZE="24M"
# BR2_TARGET_ROOTFS_TAR is not set
BR2_TARGET_OPTEE_OS=y
BR2_TARGET_OPTEE_OS_CUSTOM_TARBALL=y
BR2_TARGET_OPTEE_OS_CUSTOM_TARBALL_LOCATION="$(call github,andestech,optee_os,optee_ast540_v4.3)/optee_os-optee_ast540_v4.3.tar.gz"
BR2_TARGET_OPTEE_OS_NEEDS_PYTHON_CRYPTOGRAPHY=y
BR2_TARGET_OPTEE_OS_PLATFORM="ae350"
BR2_TARGET_OPTEE_OS_ADDITIONAL_VARIABLES="ARCH=riscv CFG_TEE_CORE_NB_CORE=1 CFG_NUM_THREADS=2 CFG_UNWIND=y CFG_IN_TREE_EARLY_TAS=trusted_keys/f04a0fe7-1f5d-4b9b-abf7-619b85b4ce8c mem_usage CFG_CORE_HEAP_SIZE=524288 CFG_TEE_RAM_VA_SIZE=0x00800000 CFG_TDDRAM_SIZE=0x04000000 CFG_PKCS11_TA_HEAP_SIZE=131072"
BR2_TARGET_OPTEE_OS_CORE_IMAGES="tee.bin"
BR2_TARGET_OPENSBI=y
BR2_TARGET_OPENSBI_CUSTOM_TARBALL=y
BR2_TARGET_OPENSBI_CUSTOM_TARBALL_LOCATION="$(call github,andestech,opensbi,optee_ast540_v4.3)/opensbi-optee_ast540_v4.3.tar.gz"
BR2_TARGET_OPENSBI_PLAT="generic"
# BR2_TARGET_OPENSBI_INSTALL_JUMP_IMG is not set
BR2_TARGET_UBOOT=y
BR2_TARGET_UBOOT_BUILD_SYSTEM_KCONFIG=y
BR2_TARGET_UBOOT_CUSTOM_TARBALL=y
BR2_TARGET_UBOOT_CUSTOM_TARBALL_LOCATION="$(call github,andestech,uboot,optee_ast540_v4.3)/uboot-optee_ast540_v4.3.tar.gz"
BR2_TARGET_UBOOT_BOARD_DEFCONFIG="ae350_rv64_spl_xip"
BR2_TARGET_UBOOT_CONFIG_FRAGMENT_FILES="board/andes/ae350-optee/uboot.config.fragment"
BR2_TARGET_UBOOT_NEEDS_PYLIBFDT=y
BR2_TARGET_UBOOT_NEEDS_OPENSSL=y
BR2_TARGET_UBOOT_NEEDS_OPTEE_TEE=y
BR2_TARGET_UBOOT_NEEDS_OPTEE_TEE_BIN=y
BR2_TARGET_UBOOT_NEEDS_OPENSBI=y
# BR2_TARGET_UBOOT_FORMAT_BIN is not set
BR2_TARGET_UBOOT_FORMAT_CUSTOM=y
BR2_TARGET_UBOOT_FORMAT_CUSTOM_NAME="u-boot.itb"
BR2_TARGET_UBOOT_SPL=y
BR2_TARGET_UBOOT_CUSTOM_MAKEOPTS="SWDTB=1"
BR2_PACKAGE_HOST_ANDES_SPI_BURN=y
BR2_PACKAGE_HOST_DOSFSTOOLS=y
BR2_PACKAGE_HOST_GENIMAGE=y
BR2_PACKAGE_HOST_MTOOLS=y
```

## configs/qemu_riscv64_ae350_ax45mpv_defconfig
```kconfig
BR2_riscv=y
BR2_TOOLCHAIN_EXTERNAL=y
BR2_GLOBAL_PATCH_DIR="board/qemu/riscv64-ae350-ax45mpv/patches"
BR2_DOWNLOAD_FORCE_CHECK_HASHES=y
BR2_SYSTEM_DHCP="eth0"
BR2_ROOTFS_POST_IMAGE_SCRIPT="board/qemu/post-image.sh"
BR2_ROOTFS_POST_SCRIPT_ARGS="$(BR2_DEFCONFIG)"
BR2_LINUX_KERNEL=y
BR2_LINUX_KERNEL_CUSTOM_TARBALL=y
BR2_LINUX_KERNEL_CUSTOM_TARBALL_LOCATION="$(call github,andestech,linux,db97808ee76135daff648df6aef40a5828d2d869)/linux-db97808ee76135daff648df6aef40a5828d2d869.tar.gz"
BR2_LINUX_KERNEL_DEFCONFIG="ae350_rv64_smp"
BR2_LINUX_KERNEL_CONFIG_FRAGMENT_FILES="board/qemu/riscv64-ae350-ax45mpv/linux.config.fragment"
BR2_LINUX_KERNEL_DTS_SUPPORT=y
BR2_LINUX_KERNEL_INTREE_DTS_NAME="andes/ax45mpv_c2_d_dsp_ae350"
BR2_TARGET_ROOTFS_EXT2=y
BR2_TARGET_ROOTFS_INITRAMFS=y
BR2_TARGET_OPENSBI=y
BR2_TARGET_OPENSBI_CUSTOM_TARBALL=y
BR2_TARGET_OPENSBI_CUSTOM_TARBALL_LOCATION="$(call github,andestech,opensbi,6005a1b252ac0d7aa4f8d9cfd4d35b076b9dad8c)/opensbi-6005a1b252ac0d7aa4f8d9cfd4d35b076b9dad8c.tar.gz"
BR2_TARGET_OPENSBI_PLAT="generic"
# BR2_TARGET_OPENSBI_INSTALL_JUMP_IMG is not set
BR2_TARGET_UBOOT=y
BR2_TARGET_UBOOT_BUILD_SYSTEM_KCONFIG=y
BR2_TARGET_UBOOT_CUSTOM_TARBALL=y
BR2_TARGET_UBOOT_CUSTOM_TARBALL_LOCATION="$(call github,andestech,uboot,777ecdea665976baff7410dc45ac0fba5820f5e8)/uboot-777ecdea665976baff7410dc45ac0fba5820f5e8.tar.gz"
BR2_TARGET_UBOOT_BOARD_DEFCONFIG="ae350_rv64_spl"
BR2_TARGET_UBOOT_CONFIG_FRAGMENT_FILES="board/qemu/riscv64-ae350-ax45mpv/uboot.config.fragment"
BR2_TARGET_UBOOT_NEEDS_OPENSBI=y
# BR2_TARGET_UBOOT_FORMAT_BIN is not set
BR2_TARGET_UBOOT_FORMAT_CUSTOM=y
BR2_TARGET_UBOOT_FORMAT_CUSTOM_NAME="u-boot.itb"
BR2_TARGET_UBOOT_SPL=y
BR2_TARGET_UBOOT_SPL_NAME="spl/u-boot-spl"
BR2_PACKAGE_HOST_QEMU=y
BR2_PACKAGE_HOST_QEMU_SYSTEM_MODE=y
```

## configs/qemu_riscv64_kvm_ae350_defconfig
```kconfig
# Architecture
BR2_riscv=y
BR2_RISCV_ISA_RVC=y

# Toolchain
BR2_GCC_VERSION_14_X=y

# System
BR2_SYSTEM_DHCP="eth0"
BR2_TARGET_GENERIC_GETTY_PORT="ttyS0"

# Image
BR2_GLOBAL_PATCH_DIR="board/andes/ae350/qemu/patches"
BR2_ROOTFS_OVERLAY="board/andes/ae350/qemu/rootfs_overlay"
BR2_ROOTFS_POST_BUILD_SCRIPT="board/andes/ae350/qemu/post-build.sh"
BR2_ROOTFS_POST_IMAGE_SCRIPT="support/scripts/genimage.sh"
BR2_ROOTFS_POST_SCRIPT_ARGS="${BR2_DEFCONFIG} -c board/andes/ae350/qemu/genimage_sdcard.cfg"

# Linux headers same as kernel
BR2_PACKAGE_HOST_LINUX_HEADERS_CUSTOM_6_6=y

# Kernel
BR2_LINUX_KERNEL=y
BR2_LINUX_KERNEL_CUSTOM_TARBALL=y
BR2_LINUX_KERNEL_CUSTOM_TARBALL_LOCATION="$(call github,andestech,linux,62f0764ee0753220b21eb7da6c5aac0778c61e61)/linux-62f0764ee0753220b21eb7da6c5aac0778c61e61.tar.gz"
BR2_LINUX_KERNEL_DEFCONFIG="ae350_rv64_smp"
BR2_LINUX_KERNEL_CONFIG_FRAGMENT_FILES="board/andes/ae350/qemu/linux.config.fragment"
BR2_LINUX_KERNEL_IMAGE=y
BR2_LINUX_KERNEL_DTS_SUPPORT=y
BR2_LINUX_KERNEL_INTREE_DTS_NAME="andes/ax66_c1_d_ae350"

# Filesystem
# BR2_TARGET_ROOTFS_TAR is not set
BR2_TARGET_ROOTFS_EXT2_SIZE="512M"
BR2_TARGET_ROOTFS_EXT2=y
BR2_TARGET_ROOTFS_EXT2_4=y

# OpenSBI
BR2_TARGET_OPENSBI=y
BR2_TARGET_OPENSBI_CUSTOM_TARBALL=y
BR2_TARGET_OPENSBI_CUSTOM_TARBALL_LOCATION="$(call github,andestech,opensbi,6bc151c581803354cd0327b69b9335b32901d537)/opensbi-6bc151c581803354cd0327b69b9335b32901d537.tar.gz"
BR2_TARGET_OPENSBI_PLAT="generic"
# BR2_TARGET_OPENSBI_INSTALL_JUMP_IMG is not set

# Uboot
BR2_TARGET_UBOOT=y
BR2_TARGET_UBOOT_BUILD_SYSTEM_KCONFIG=y
BR2_TARGET_UBOOT_CUSTOM_TARBALL=y
BR2_TARGET_UBOOT_CUSTOM_TARBALL_LOCATION="$(call github,andestech,uboot,274c8e532c6fc30bb680661f420984e1031814cf)/uboot-274c8e532c6fc30bb680661f420984e1031814cf.tar.gz"
BR2_TARGET_UBOOT_BOARD_DEFCONFIG="ae350_rv64_spl_imsic"
BR2_TARGET_UBOOT_CONFIG_FRAGMENT_FILES="board/andes/ae350/qemu/uboot.config.fragment"
BR2_TARGET_UBOOT_NEEDS_PYLIBFDT=y
BR2_TARGET_UBOOT_NEEDS_OPENSSL=y
BR2_TARGET_UBOOT_NEEDS_OPENSBI=y
# BR2_TARGET_UBOOT_FORMAT_BIN is not set
BR2_TARGET_UBOOT_FORMAT_CUSTOM=y
BR2_TARGET_UBOOT_FORMAT_CUSTOM_NAME="u-boot.itb"
BR2_TARGET_UBOOT_SPL=y
BR2_TARGET_UBOOT_SPL_NAME="spl/u-boot-spl"
BR2_UBOOT_BINMAN_INDIRS="$(BINARIES_DIR)"

# QEMU for host platform
BR2_PACKAGE_HOST_QEMU=y
BR2_PACKAGE_HOST_QEMU_SYSTEM_MODE=y

# QEMU for target platform
BR2_PACKAGE_QEMU=y
BR2_PACKAGE_QEMU_SYSTEM=y
BR2_PACKAGE_QEMU_SLIRP=y
BR2_PACKAGE_QEMU_CHOOSE_TARGETS=y
BR2_PACKAGE_QEMU_TARGET_RISCV64=y
BR2_PACKAGE_QEMU_TOOLS=y

# Host Package
BR2_PACKAGE_HOST_DOSFSTOOLS=y
BR2_PACKAGE_HOST_GENIMAGE=y
BR2_PACKAGE_HOST_MTOOLS=y
```

## toolchain/toolchain-external/toolchain-external-andes-riscv64/Config.in
```kconfig
config BR2_TOOLCHAIN_EXTERNAL_ANDES_RISCV64
	bool "Andes Technology AndeSight Toolchain v5.3.0"
	depends on BR2_riscv
	depends on BR2_ARCH_IS_64
	select BR2_TOOLCHAIN_EXTERNAL_GLIBC
	select BR2_TOOLCHAIN_HAS_SSP
	select BR2_INSTALL_LIBSTDCPP
	select BR2_TOOLCHAIN_HEADERS_AT_LEAST_6_1
	select BR2_TOOLCHAIN_GCC_AT_LEAST_12
	select BR2_TOOLCHAIN_HAS_FORTRAN
	select BR2_TOOLCHAIN_HAS_OPENMP
	help
	  Toolchain for the Andes RISC-V architecture, from
	  https://github.com/andestech/Andes-Development-Kit/releases
```
